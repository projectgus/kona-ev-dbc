VERSION ""

NS_ :

BO_ 263 UNK_B107: 8 XXX
 SG_ NEW_SIGNAL_1 : 39|16@0+ (1,0) [0|255] "a" XXX

BO_ 272 SMK_B110: 8 SMK
 SG_ MAYBE_POWER_PRESSED : 0|8@1+ (1,0) [0|255] "" XXX
 SG_ MAYBE_POWER_STATUS : 16|8@1+ (1,0) [0|255] "" XXX

BO_ 273 SMK_B111: 8 SMK

BO_ 274 SMK_B112: 8 SMK
 SG_ UNK_STATUS : 23|8@0+ (1,0) [0|255] "" XXX

BO_ 275 SMK_B113: 8 SMK

BO_ 1025 SMK_B401: 8 SMK

BO_ 1296 SMK_B510: 8 SMK

CM_ SG_ 274 UNK_STATUS "LSB flips every few seconds - heartbeat?";
